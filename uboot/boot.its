## uboot/boot.its
```
/dts-v1/;

/ {
	description = "Various kernels, ramdisks and FDT blobs";
	#address-cells = <1>;

	images {
		kernel-1 {
			description = "cvitek kernel";
			data = /incbin/("kernel");
			type = "kernel";
			arch = "riscv";
			os = "linux";
			compression = "none";
			load = <0x80200000>;
			entry = <0x80200000>;
			hash-1 {
				algo = "crc32";
			};
		};

		fdt-sg2002_licheervnano_sd {
			description = "cvitek device tree - sg2002_licheervnano_sd";
			data = /incbin/("fdt.dtb");
			type = "flat_dt";
			arch = "riscv";
			compression = "none";
			hash-1 {
				algo = "sha256";
			};
		};
	};

	configurations {
		default = "config-sg2002_licheervnano_sd";
		config-sg2002_licheervnano_sd {
			description = "boot cvitek system with board sg2002_licheervnano_sd";
			kernel = "kernel-1";
			fdt = "fdt-sg2002_licheervnano_sd";
		};
	};
};
```
