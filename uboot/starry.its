## uboot/starry.its
```
/dts-v1/;

/ {
	description = "StarryOS kernel with FDT blob";
	#address-cells = <1>;

	images {
		kernel-1 {
			description = "StarryOS kernel";
			data = /incbin/("KERNEL");
			type = "kernel";
			arch = "riscv";
			os = "linux";
			compression = "none";
			load = <0x80200000>;
			entry = <0x80200000>;
			hash-1 {
				algo = "crc32";
			};
		};

		fdt-sg2002_licheervnano_sd {
			description = "StarryOS device tree - sg2002_licheervnano_sd";
			data = /incbin/("DTB");
			type = "flat_dt";
			arch = "riscv";
			compression = "none";
			hash-1 {
				algo = "sha256";
			};
		};
	};

	configurations {
		default = "config-sg2002_licheervnano_sd";
		config-sg2002_licheervnano_sd {
			description = "Boot StarryOS on sg2002_licheervnano_sd";
			kernel = "kernel-1";
			fdt = "fdt-sg2002_licheervnano_sd";
		};
	};
};
```
